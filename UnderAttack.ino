

//ThaddeusSM
//03/16/18

//Libraries
#include <Arduboy2.h>
#include <FixedPoints.h>
#include <FixedPointsCommon.h>
#define MAX_GUN_ANGLE 1.05
#define MIN_GUN_ANGLE -1.05
#define NUMBER_OF_BULLETS 10
#define NUMBER_OF_SOLDIERS 10

Arduboy2 arduboy;


//Variables
const unsigned char titleScreen[] PROGMEM = { 
  0xff, 0xff, 0xff, 0xff, 0xff, 0xff, 0xff, 0xff, 0xff, 0xff, 0xff, 0xff,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 0xff, 
};
const unsigned char PROGMEM Gameplay1[] = {
// width, height,
128, 64,
0x00, 0x00, 0x00, 0x00, 0x00, 0x00, 0x00, 0x00, 0x00, 0x00, 0x00, 0x00,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 0x00, 
0xff, 0x7f, 0x3e, 0x18, 0x18, 0xf8, 0x1e, 0x1f, 0x3f, 0x7e, 0xf8, 0xf8,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 0x00, 
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0x00, 0x00, 0x08, 0x18, 0x00, 0x02, 0x03, 0x00, 0x00, 0x00, 0x0c, 0x08,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 0x00, 
};
const unsigned char PROGMEM Soldier1[] = {
// width, height,
16, 16,
0x80, 0x80, 0x80, 0x00, 0x70, 0xc8, 0xe8, 0xc8, 0xf0, 0x00, 0x00, 0x00, 0x00, 0x00, 0x00, 0x00, 
0x00, 0x01, 0x02, 0x01, 0x01, 0x0f, 0x3b, 0x03, 0x3f, 0x01, 0x00, 0x00, 0x00, 0x00, 0x00, 0x00, 
};
const unsigned char PROGMEM Soldier2[] = {
// width, height,
16, 16,
0x80, 0x80, 0x80, 0x00, 0x70, 0xc8, 0xe8, 0xc8, 0xf0, 0x00, 0x00, 0x00, 0x00, 0x00, 0x00, 0x00, 
0x00, 0x01, 0x02, 0x01, 0x01, 0x3f, 0x03, 0x3b, 0x0f, 0x01, 0x00, 0x00, 0x00, 0x00, 0x00, 0x00, 
};

int gamestate = 0;
const int x1 = 20;
const int y1 = 27;
float gunAngle = 0.0;
const float GAinc = 0.15;
int x2;
int y2;
int x3;
int y3;
int score = 0;
struct Bullet {
  uint8_t x;
  uint8_t y;
  uint8_t xDelta;
  int8_t yDelta;
  bool active;
};
struct Soldier {
  uint8_t x;
  uint8_t y;
  int8_t xDelta;
  int8_t yDelta;
  bool active;
};



Bullet bullets[NUMBER_OF_BULLETS];
//Bullet bullet = {28, 27, 1, -1, false};
Soldier soldiers[NUMBER_OF_SOLDIERS];




//Setup Script
void setup() {
  arduboy.begin();
  arduboy.initRandomSeed();
  arduboy.setFrameRate(60);
  arduboy.clear();
}

//Game Code
void loop() {
  if(!arduboy.nextFrame()) {
    return;
  }
  arduboy.pollButtons();
  arduboy.clear();
  switch(gamestate){
    case 0:
    arduboy.drawBitmap(0, 0, titleScreen, 128, 64, WHITE);
    if(arduboy.justPressed(A_BUTTON)) {
      gamestate = 1;
    }
      break;
    case 1:
    arduboy.drawBitmap(0, 0, Gameplay1, 128, 64, WHITE);
    x2 = x1 + cos(gunAngle) * 8;
    y2 = y1 + sin(gunAngle) * 8;
    arduboy.drawLine(x1, y1, x2, y2, WHITE);
    if(arduboy.justPressed(A_BUTTON)) {
      gamestate = 0;
    }
    if(arduboy.justPressed(UP_BUTTON) or arduboy.justPressed(LEFT_BUTTON)) {
      if(gunAngle > MIN_GUN_ANGLE){
        gunAngle = gunAngle - GAinc;
      }
    }
    if(arduboy.justPressed(DOWN_BUTTON) or arduboy.justPressed(RIGHT_BUTTON)){
      if(gunAngle < MAX_GUN_ANGLE){
         gunAngle = gunAngle + GAinc;
      } 
    }
     
     if(arduboy.justPressed(B_BUTTON)) {
        for (uint8_t x = 0; x < NUMBER_OF_BULLETS; x++) {

          if (!bullets[x].active) {
            bullets[x].x = x2;
            bullets[x].y = y2;
            bullets[x].xDelta = cos(gunAngle)*5;
            bullets[x].yDelta = sin(gunAngle)*7;
            bullets[x].active = true;
            break;  // We found one so we can leave the loop.
            
          }
          
        }
     }
      if(score > -1) {
        for (uint8_t x = 0; x < NUMBER_OF_SOLDIERS; x++) {

          if (!soldiers[x].active) {
            soldiers[x].x = 128;
            soldiers[x].y = 50;
            soldiers[x].xDelta = 1;
            soldiers[x].yDelta = 0;
            soldiers[x].active = true;
            break; 
            
          }
          
        }
     }





    // Render the bullets ..

    for (uint8_t x = 0; x < NUMBER_OF_BULLETS; x++) {
    
      if (bullets[x].active) {
      
        arduboy.drawPixel(bullets[x].x, bullets[x].y, WHITE);

      }
      
    }
    for (uint8_t x = 0; x < NUMBER_OF_SOLDIERS; x++) {
    
      if (soldiers[x].active) {
      
        arduboy.drawBitmap(soldiers[x].x, soldiers[x].y, Soldier1, 16, 16, WHITE);

      }
      
    }






    // Move the bullets ..

    for (uint8_t x = 0; x < NUMBER_OF_BULLETS; x++) {
    
      if (bullets[x].active) {
      
        bullets[x].x += bullets[x].xDelta; 
        bullets[x].y += bullets[x].yDelta;

        // Out of range ?

        if (bullets[x].x > WIDTH || bullets[x].y < 0 || bullets[x].y > HEIGHT) {

          bullets[x].active = false;
          
        }

      }
      
    }
    for (uint8_t x = 0; x < NUMBER_OF_SOLDIERS; x++) {
    
      if (soldiers[x].active) {
      
        soldiers[x].x += soldiers[x].xDelta; 
        soldiers[x].y += bullets[x].yDelta;

        // Out of range ?

        if (bullets[x].x > 28 || bullets[x].y < 0 || bullets[x].y > HEIGHT) {

          soldiers[x].active = false;
          
        }

      }
      
    }

    arduboy.setCursor(0, 0);
    arduboy.print(score);

      break;
    }


   
   arduboy.display();
}
